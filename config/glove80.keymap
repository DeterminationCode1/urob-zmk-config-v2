// clang-format off
#define CONFIG_WIRELESS
#define ZMK_BASE_LAYER(name, LT, RT, LM, RM, LB, RB, LH, RH)                                      \
    ZMK_LAYER(                                                                                    \
        name,                                                                                     \
        &kp F1    &kp F2 &kp F3 &kp F4 &kp F5               &kp F6 &kp F7 &kp F8 &kp F9 &kp F10   \
        &kp EQUAL &kp N1 &kp N2 &kp N3 &kp N4 &kp N5 &kp N6 &kp N7 &kp N8 &kp N9 &kp N0 &kp MINUS \
        &kp TAB              LT                                            RT           &kp BSPC  \
        &kp ESC              LM                                            RM           &sk LCTRL \
        &kp GRAVE            LB &kp RET  &kp SPACE  &kp SPACE  &none  &kp SLASH &kp EQUAL    RB     &sk LALT  \
                                &none  &kp BSPC &kp MINUS                                         \
        &kp LEFT  &kp RIGHT  LH &kp SPACE                         &none    RH &kp DOWN &kp UP  \
                                                     &kp LBKT  &kp PG_DN &kp PG_UP)

#include "zmk-helpers/key-labels/glove80.h"
#include "base.keymap"
